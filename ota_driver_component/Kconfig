## ota_driver_component/Kconfig
```kconfig
menu "ota_driver_component"
config version
    string "firmwareVersion"      
    default 0.1
config site_url
    string "SiteUrl"
    default "localhost:8080/"
    help
    blank help
config FIRMWARE_UPGRADE_URL
    string "firmware upgrade url endpoint"
    default "https://192.168.0.3:8070/hello-world.bin"
    help
        URL of server which hosts the firmware
        image.
endmenu
```
